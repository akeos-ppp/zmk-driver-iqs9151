## dts/bindings/behaviors/zmk,behavior-touch-feedback.yaml
```yaml
description: Enable or disable local IQS9151 touch feedback on both connected halves
compatible: "zmk,behavior-touch-feedback"
include: one_param.yaml
```

## dts/bindings/haptic/zmk,drv2605.yaml
```yaml
description: TI DRV2605L Haptic Motor Controller

compatible: "zmk,drv2605"

include: i2c-device.yaml

properties:
  resonance-hz:
    type: int
    default: 175
    description: LRA nominal resonance in Hz (125 to 300); sets drive time and rated voltage.

  actuator-type:
    type: string
    default: "lra"
    enum:
      - "lra"
      - "erm"
    description: |
      Actuator type. "lra" selects the internal LRA library and feedback
      control mode (closed-loop). "erm" selects the ERM (eccentric rotating
      mass) library.

  rated-voltage-mv:
    type: int
    default: 2000
    description: |
      Rated voltage of the actuator in millivolts (RMS for LRA, DC for ERM).
      Used to compute the RATED_VOLTAGE register value. Default 2000 mV
      matches the Vybronics VG1040003D LRA.

  overdrive-voltage-mv:
    type: int
    default: 2400
    description: |
      Peak overdrive (clamp) voltage in millivolts, not RMS. Determines maximum drive
      voltage during effect playback. Should be at most the actuator's
      absolute maximum rating. Default 2400 mV.

  library:
    type: int
    default: 6
    description: |
      Built-in effect library to select (register 0x03). For LRAs use 6.
      For ERMs valid values are 1-5 selecting library A-E.
```
